## boards/shields/7skb/Kconfig.defconfig
```kconfig
if SHIELD_7SKB_LEFT

config ZMK_KEYBOARD_NAME
    default "7skb"

config ZMK_SPLIT_ROLE_CENTRAL
    default y
    
endif

if SHIELD_7SKB_LEFT || SHIELD_7SKB_RIGHT

config ZMK_SPLIT
    default y

endif
```

## boards/shields/7skb/Kconfig.shield
```kconfig
config SHIELD_7SKB_LEFT
    def_bool $(shields_list_contains,7skb_left)
config SHIELD_7SKB_RIGHT
    def_bool $(shields_list_contains,7skb_right)
```
